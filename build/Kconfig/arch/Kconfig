## build/Kconfig/arch/Kconfig
```kconfig
# Load Zephyr Arch Kconfig descriptions.
osource "/home/jugal/zephyrproject/zephyr/arch/rx/Kconfig"
osource "/home/jugal/zephyrproject/zephyr/arch/x86/Kconfig"
osource "/home/jugal/zephyrproject/zephyr/arch/xtensa/Kconfig"
osource "/home/jugal/zephyrproject/zephyr/arch/sparc/Kconfig"
osource "/home/jugal/zephyrproject/zephyr/arch/riscv/Kconfig"
osource "/home/jugal/zephyrproject/zephyr/arch/posix/Kconfig"
osource "/home/jugal/zephyrproject/zephyr/arch/mips/Kconfig"
osource "/home/jugal/zephyrproject/zephyr/arch/arm64/Kconfig"
osource "/home/jugal/zephyrproject/zephyr/arch/arm/Kconfig"
osource "/home/jugal/zephyrproject/zephyr/arch/arc/Kconfig"
```

## build/Kconfig/boards/Kconfig.defconfig
```kconfig
# Load Zephyr board defconfig descriptions.
osource "/home/jugal/zephyrproject/zephyr/boards/espressif/esp32_ethernet_kit/Kconfig.defconfig"
```

## build/Kconfig/boards/Kconfig.esp32_ethernet_kit
```kconfig
# Load board Kconfig descriptions.
osource "/home/jugal/zephyrproject/zephyr/boards/espressif/esp32_ethernet_kit/Kconfig.esp32_ethernet_kit"
```
